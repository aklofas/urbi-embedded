## examples/esp32/eye_demo/main/Kconfig.projbuild
```kconfig
menu "Eye Demo Configuration"
    config EYE_DEMO_ENABLE_CAMERA
        bool "Enable the OV2640 camera"
        default y
        help
            Off, the demo runs the display, the button, the session and
            the reactive workload without a camera: a smoke test on an
            S3 board that is not the EYE.
    config URBI_ARENA_BYTES
        int "urbi heap arena (bytes, internal SRAM)"
        default 131072
        range 65536 262144
        help
            The static arena the runtime allocates from.  The collector
            is told three quarters of it as its budget; the rest covers
            the allocator's block headers and the memory the collector
            does not track.  The boot log prints the free internal heap
            beside it so the headroom is visible.  Values above the
            default may not link beside the display's static frame buffer.
endmenu
```

## tests/qemu/reactive_smoke/main/Kconfig.projbuild
```kconfig
menu "Reactive Smoke Configuration"
    config URBI_ARENA_BYTES
        int "urbi heap arena (bytes, internal SRAM)"
        default 131072
        range 65536 262144
        help
            The static arena the runtime allocates from, the same figure
            the ESP32-S3-EYE demo uses so the smoke measures the board's
            configuration.  The collector is told three quarters of it.
endmenu
```
